## ports/hardware/S3/ESP32-S3-Generic-16IO/sdkconfig.defaults
```kconfig
# ESP32-S3-Generic-16IO — 硬體事實（16 IO × 16×16 功能測試）
# 對應 board.json／wiring.json；改這裡要 --fresh rebuild。
CONFIG_ESPTOOLPY_FLASHSIZE_4MB=y
CONFIG_ESPTOOLPY_FLASHFREQ_80M=y
CONFIG_ESPTOOLPY_FLASHMODE_DIO=y
CONFIG_SPIRAM=y
CONFIG_SPIRAM_MODE_QUAD=y
CONFIG_SPIRAM_SPEED_80M=y
CONFIG_ESP_DEFAULT_CPU_FREQ_MHZ_240=y
CONFIG_ESP_CONSOLE_NONE=y
CONFIG_ESP_CONSOLE_SECONDARY_NONE=y
CONFIG_PARTITION_TABLE_CUSTOM=y
CONFIG_PARTITION_TABLE_CUSTOM_FILENAME="../ports/hardware/S3/ESP32-S3-Generic-16IO/partitions.csv"
CONFIG_NETCORE_PIXEL=y
CONFIG_NETCORE_PIXEL_LEDS=256
CONFIG_NETCORE_PIXEL_FORMAT="ws2812"
CONFIG_NETCORE_PIXEL_I80=y
CONFIG_NETCORE_PIXEL_I80_DIRECT=y
CONFIG_NETCORE_PIXEL_I80_PINS="1,2,4,5,6,7,8,9,10,11,12,13,14,15,21,38"
CONFIG_NETCORE_PIXEL_I80_LANES=16
CONFIG_NETCORE_PIXEL_I80_BUS_WIDTH=16
CONFIG_NETCORE_PIXEL_PCLK_HZ=2500000
CONFIG_NETCORE_PIXEL_BIT_CELLS=3
CONFIG_NETCORE_PIXEL_T0H=1
CONFIG_NETCORE_PIXEL_T1H=2
CONFIG_NETCORE_PIXEL_DITHER=1
CONFIG_NETCORE_PIXEL_DITHER_BITS=12
CONFIG_NETCORE_PIXEL_RING_PSRAM=y
CONFIG_NETCORE_PIXEL_PACK_PSRAM=y
CONFIG_NETCORE_PIXEL_SPI=n
CONFIG_NETCORE_CONTENT=y
```

## ports/project/S3/ESP32-S3-Generic-16IO/sdkconfig.defaults
```kconfig
# 功能測試 project：板子事實（flash/PSRAM/16 lane/幾何）在 hardware 層。
CONFIG_ESP_MAIN_TASK_STACK_SIZE=8192
CONFIG_NETCORE_PIXEL_HOT_SRAM_KB=0
CONFIG_NETCORE_PIXEL_LAYOUT_PREBUILD_MAX=0
```

## ports/project/S3/ESP32-S3-Generic-NoPSRAM/sdkconfig.defaults
```kconfig
# 中央示範 pair：project 層只放功能覆寫；板子事實（flash/PSRAM/腳位/幾何）在 hardware 層。
CONFIG_ESP_MAIN_TASK_STACK_SIZE=8192
```

## ports/project/S3/ESP32-S3-Matrix-EffectPerf/sdkconfig.defaults
```kconfig
# ESP32-S3-Matrix-EffectPerf — 只加 effect_bench，不改任何硬體事實。
#
# 硬體事實（flash／PSRAM／CPU／console／分區表／燈的腳位與顆數）一律留在
# ports/hardware/S3/ESP32-S3-Matrix/sdkconfig.defaults；project 只覆寫「這個映像
# 多編哪個功能」。
#
# 不開 NC_ENABLE_TESTS：
#   effect_bench 是 CONFIG_NETCORE_EFFECT_BENCH 的獨立 component，
#   不是 test_action 的 58 條測試指令，所以不會把 network／ncm／0xF060–0xF064 拉進來。
CONFIG_NETCORE_EFFECT_BENCH=y
# 這不是吞吐量映像；PXBENCH 保持關閉（它屬於 test_action，本來就不會進來）。
CONFIG_NETCORE_PXBENCH=n
```

## ports/project/S3/ESP32-S3-Zero-Show2400/sdkconfig.defaults
```kconfig
# 10-bit 抖動：4 子幀、200 Hz 子幀率、環 5 格。
CONFIG_NETCORE_CONTENT=y
CONFIG_NETCORE_PXBENCH=n
CONFIG_ESP_MAIN_TASK_STACK_SIZE=8192
CONFIG_NETCORE_PIXEL_PACK_PSRAM=y
CONFIG_NETCORE_PIXEL_RING_PSRAM=y
CONFIG_NETCORE_PIXEL_LEDS=2400
CONFIG_NETCORE_PIXEL_SUBFRAMES=4
CONFIG_NETCORE_PIXEL_RING_SLOTS=5
CONFIG_NETCORE_PIXEL_FPS=200

# 量 CPU：render 只用 mock lane（硬件層已另行驗證）。
CONFIG_NETCORE_PIXEL_MOCK_ONLY=y
# 畫波／推送分兩個 loop（trial：mock 後端先驗編譯同排程）
CONFIG_NETCORE_PX_SPLIT_PUSH=y
```
